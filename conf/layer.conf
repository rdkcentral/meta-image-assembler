## conf/layer.conf
```bitbake
# We have a conf and classes directory, add to BBPATH
BBPATH .= ":${LAYERDIR}"

# We have recipes-* directories, add to BBFILES
BBFILES += "${LAYERDIR}/recipes-*/*/*.bb \
            ${LAYERDIR}/recipes-*/*.bb \
            ${LAYERDIR}/recipes-*/*.bbappend \
            ${LAYERDIR}/recipes-*/*/*.bbappend"

BBFILE_COLLECTIONS += "image-assembler"
BBFILE_PATTERN_image-assembler = "^${LAYERDIR}/"
BBFILE_PRIORITY_image-assembler = "6"

LAYERDEPENDS_image-assembler = "core"
LAYERSERIES_COMPAT_image-assembler = "dunfell kirkstone"

require include/volatile-binds-config.inc
#Enable this Variable is used to fetch the ipk's from artifactory instead of building it from source
SKIP_RECIPE_IPK_PKGS ="1"

#Enable this variable along with the SKIP_RECIPE_IPK_PKGS is used to organizes IPK packages into separate staging directories based on the target architecture
TARGET_BASED_IPK_STAGING = "1"
```
